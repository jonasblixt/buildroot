/*
 * Copyright 2017-2018 NXP
 *
 * This program is free software; you can redistribute it and/or
 * modify it under the terms of the GNU General Public License
 * as published by the Free Software Foundation; either version 2
 * of the License, or (at your option) any later version.
 *
 * This program is distributed in the hope that it will be useful,
 * but WITHOUT ANY WARRANTY; without even the implied warranty of
 * MERCHANTABILITY or FITNESS FOR A PARTICULAR PURPOSE.  See the
 * GNU General Public License for more details.
 */

/dts-v1/;

#include "freescale/fsl-imx8qxp-mek.dtsi"

/ {

    chosen {
        bootargs = "---------------------------------------------------------------------------------------------------------------------------------------------------------------------------";
        stdout-path = &lpuart0;
        linux,initrd-start = <0x00000000>;
        linux,initrd-end = <0x00000000>;
        device-uuid = "00000000-0000-0000-0000-000000000000";
        active-system = "?";
        pb,boot-time = <0>;
        pb,slc = <0>;
        pb,slc-available-keys = <>;
        pb,slc-active-key = <0x00000000>;
    };

    firmware {
        optee {
            compatible = "linaro,optee-tz";
            method = "smc";
        };
    };
};
