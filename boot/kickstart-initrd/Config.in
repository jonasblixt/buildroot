## boot/kickstart-initrd/Config.in
```kconfig
config BR2_TARGET_KICKSTART_INITRD
	bool "Kickstart-initrd"
    select BR2_PACKAGE_HOST_BPAK
    select BR2_PACKAGE_UTIL_LINUX
    select BR2_PACKAGE_UTIL_LINUX_LIBBLKID
    select BR2_PACKAGE_UTIL_LINUX_LIBUUID
	help
        The kickstart initrd

config BR2_KICKSTART_INITRD_KEYSTORE
    depends on BR2_TARGET_KICKSTART_INITRD
    string "Keystore bpak file"
```

## boot/punchboot/Config.in
```kconfig
config BR2_TARGET_PUNCHBOOT
	bool "Punchboot"
    depends on BR2_PACKAGE_HOST_BPAK
    depends on BR2_PACKAGE_HOST_PYTHON3
	help
	  Build punchboot bootloader

config BR2_PUNCHBOOT_DEFCONFIG
    depends on BR2_TARGET_PUNCHBOOT
    string "Punchboot configuration file"
```

## package/nxpcst/Config.in.host
```kconfig
config BR2_PACKAGE_HOST_NXPCST
	bool "NXP Code signing tool"
    select BR2_PACKAGE_HOST_OPENSSL
	help
        NXP's Code Signing Tool (CST)
```

## package/opensc/Config.in
```kconfig
config BR2_PACKAGE_OPENSC
 bool "opensc"
 depends on BR2_TOOLCHAIN_HAS_THREADS # pcsc-lite, libusb
 depends on BR2_USE_MMU # pcsc-lite
 depends on BR2_USE_WCHAR # wprintf
 depends on !BR2_STATIC_LIBS # pcsc-lite
 select BR2_PACKAGE_LIBUSB
 select BR2_PACKAGE_PCSC_LITE
 help
  Open source smart card tools and middleware.
  OpenSC provides a set of libraries and utilities to work with smart
  cards. Its main focus is on cards that support cryptographic
  operations, and facilitate their use in security applications such as
  authentication, mail encryption and digital signatures. OpenSC
  implements the standard APIs to smart cards, e.g. PKCS#11 API,
  Windows’ Smart Card Minidriver and macOS CryptoTokenKit.

  https://github.com/OpenSC/OpenSC

comment "opensc needs a toolchain w/ wchar threads, dynamic library"
 depends on BR2_USE_MMU
 depends on !BR2_TOOLCHAIN_HAS_THREADS || !BR2_USE_WCHAR \
 || BR2_STATIC_LIBS
```

## package/pbstate/Config.in
```kconfig
config BR2_PACKAGE_PBSTATE
	bool "pbstate"
    select BR2_PACKAGE_UTIL_LINUX
    select BR2_PACKAGE_UTIL_LINUX_LIBBLKID
    select BR2_PACKAGE_UTIL_LINUX_LIBUUID
	help
        Tool for manipulating the punchboot state data
```

## package/pbstate/Config.in.host
```kconfig
config BR2_PACKAGE_HOST_PBSTATE
	bool "host pbstate"
	help
        Host tools for punchboot pbstate
```

## package/punchboot-tools/Config.in.host
```kconfig
config BR2_PACKAGE_HOST_PUNCHBOOT_TOOLS
	bool "host punchboot-tools"
    select BR2_PACKAGE_HOST_LIBUSB
	help
        Host tools for the punchboot bootloader
```
